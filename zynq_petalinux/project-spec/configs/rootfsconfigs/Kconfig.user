## zynq_petalinux/project-spec/configs/rootfsconfigs/Kconfig.user
```kconfig
menu "user packages " 
config blink  
	 bool "blink"
	 help
	
config gpio-demo  
	 bool "gpio-demo"
	 help
	
config peekpoke  
	 bool "peekpoke"
	 help
	
endmenu
```
